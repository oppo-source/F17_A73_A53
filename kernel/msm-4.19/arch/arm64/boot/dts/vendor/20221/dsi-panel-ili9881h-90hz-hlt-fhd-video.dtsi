&mdss_mdp {
	dsi_ili9881h_90hz_hlt_video: qcom,mdss_dsi_ili9881h_90hz_hlt_video {
		qcom,mdss-dsi-panel-name =
				"ili9881h 90hz hlt fhd video mode dsi panel";
		qcom,mdss-dsi-panel-type = "dsi_video_mode";
		qcom,dsi-ctrl-num = <0>;
		qcom,dsi-phy-num = <0>;
		qcom,mdss-dsi-virtual-channel-id = <0>;
		qcom,mdss-dsi-stream = <0>;
		qcom,mdss-dsi-h-left-border = <0>;
		qcom,mdss-dsi-h-right-border = <0>;
		qcom,mdss-dsi-v-top-border = <0>;
		qcom,mdss-dsi-v-bottom-border = <0>;
		qcom,mdss-dsi-bpp = <24>;
		qcom,mdss-dsi-color-order = "rgb_swap_rgb";
		qcom,mdss-dsi-underflow-color = <0xff>;
		qcom,mdss-dsi-border-color = <0>;
		qcom,mdss-dsi-h-sync-pulse = <0>;
		qcom,mdss-dsi-traffic-mode = "non_burst_sync_event";
		qcom,mdss-dsi-lane-map = "lane_map_0123";
		qcom,mdss-dsi-bllp-eof-power-mode;
		qcom,mdss-dsi-bllp-power-mode;
		qcom,ulps-enabled;
		qcom,suspend-ulps-enabled;
		qcom,mdss-dsi-tx-eot-append;
		qcom,mdss-dsi-lane-0-state;
		qcom,mdss-dsi-lane-1-state;
		qcom,mdss-dsi-lane-2-state;
		qcom,mdss-dsi-lane-3-state;
		qcom,mdss-dsi-dma-trigger = "trigger_sw";
		qcom,mdss-dsi-mdp-trigger = "none";
		qcom,mdss-dsi-lp11-init;
		qcom,mdss-dsi-bl-pmic-control-type = "bl_ctrl_dcs";
		qcom,mdss-dsi-bl-min-level = <1>;
		qcom,mdss-dsi-bl-normal-max-level = <3562>;
		qcom,mdss-dsi-bl-max-level = <4095>;
		qcom,mdss-brightness-normal-max-level = <3562>;
		qcom,mdss-brightness-max-level = <4095>;
		qcom,mdss-brightness-default-level = <400>;
		qcom,mdss-dsi-reset-sequence = <1 10>, <0 10>, <1 10>;
		qcom,mdss-pan-physical-width-dimension = <68>;
		qcom,mdss-pan-physical-height-dimension = <151>;
		oppo,mdss-dsi-vendor-name = "ILI9881H-90HZ";
		oppo,mdss-dsi-manufacture = "HLT";
		qcom,mdss-dsi-display-timings {
			timing@0 {
				qcom,mdss-dsi-video-mode;
				qcom,mdss-dsi-panel-width = <720>;
				qcom,mdss-dsi-panel-height = <1600>;
				qcom,mdss-dsi-h-front-porch = <20>;
				qcom,mdss-dsi-h-back-porch = <36>;
				qcom,mdss-dsi-h-pulse-width = <8>;
				qcom,mdss-dsi-h-sync-skew = <0>;
				qcom,mdss-dsi-v-back-porch = <20>;
				qcom,mdss-dsi-v-front-porch = <340>;
				qcom,mdss-dsi-v-pulse-width = <8>;
				qcom,mdss-dsi-panel-framerate = <90>;
				qcom,mdss-dsi-on-command = [
					39 01 00 00 00 00 04 FF 98 81 06
					39 01 00 00 00 00 02 C7 05		//ESD
					39 01 00 00 00 00 02 06 C4		//PWM OSC*2
					39 01 00 00 00 00 04 FF 98 81 00
					39 01 00 00 00 00 02 53 24		//enable pwm
					39 01 00 00 00 00 03 51 00 00
					39 01 00 00 00 00 02 55 01	//enable cabc
					39 01 00 00 00 00 04 FF 98 81 03
					39 01 00 00 00 00 02 83 20		//12bit 17.8k
					39 01 00 00 00 00 02 84 00
					39 01 00 00 00 00 02 91 F4	 //CABC START 8.19			
					39 01 00 00 00 00 02 92 15					
					39 01 00 00 00 00 02 94 0F   
					39 01 00 00 00 00 02 95 0F
					39 01 00 00 00 00 02 96 10
					39 01 00 00 00 00 02 97 10
					39 01 00 00 00 00 02 98 11
					39 01 00 00 00 00 02 99 12
					39 01 00 00 00 00 02 9A 13
					39 01 00 00 00 00 02 9B 14
					39 01 00 00 00 00 02 9C 15
					39 01 00 00 00 00 02 9D 16
					39 01 00 00 00 00 02 89 40
					39 01 00 00 00 00 02 86 3F   //CABC END 8.19
					39 01 00 00 00 00 04 FF 98 81 00
					39 01 00 00 00 00 02 35 00		//TE
					39 01 00 00 78 00 02 11 00
					39 01 00 00 00 00 04 FF 98 81 06
					39 01 00 00 00 00 02 D6 87		//TSHD
					39 01 00 00 00 00 04 FF 98 81 05	//ADD
					39 01 00 00 00 00 02 50 2F	//ADD VGH PUMP
					39 01 00 00 00 00 02 68 8D	//ADD VGHO 14V
					39 01 00 00 00 00 02 69 93	//ADD VGH 15V
					39 01 00 00 00 00 04 FF 98 81 00
					39 01 00 00 14 00 02 29 00
				];
				qcom,mdss-dsi-off-command = [
					39 01 00 00 00 00 04 FF 98 81 00
					39 01 00 00 14 00 02 28 00
					39 01 00 00 78 00 02 10 00
				];
				qcom,mdss-dsi-cabc-low-mode-command = [
					39 01 00 00 00 00 04 FF 98 81 00
					39 01 00 00 00 00 02 55 01
				];
				qcom,mdss-dsi-cabc-high-mode-command = [
					39 01 00 00 00 00 04 FF 98 81 00
					39 01 00 00 00 00 02 55 02
				];
				qcom,mdss-dsi-cabc-off-command = [
					39 01 00 00 00 00 04 FF 98 81 00
					39 01 00 00 00 00 02 55 00
				];
				qcom,mdss-dsi-on-command-state = "dsi_lp_mode";
				qcom,mdss-dsi-off-command-state = "dsi_lp_mode";
				qcom,mdss-dsi-cabc-low-mode-command-state = "dsi_hs_mode";
				qcom,mdss-dsi-cabc-high-mode-command-state = "dsi_hs_mode";
				qcom,mdss-dsi-cabc-off-command-state = "dsi_hs_mode";
			};
		};
	};
};