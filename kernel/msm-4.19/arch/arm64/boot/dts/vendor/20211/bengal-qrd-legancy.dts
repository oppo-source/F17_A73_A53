/dts-v1/;

#include "bengal.dtsi"
#include "bengal-qrd-lengancy.dtsi"

/ {
	model = "Qualcomm Technologies, Inc. Bengal QRD";
	compatible = "qcom,bengal-qrd", "qcom,bengal", "qcom,qrd";
	qcom,board-id = <0x1000B 0>;
	oppo,dtsi_no = <20211>;
        oppo,pcb-legancy-version = <1>; // before evt2
};
