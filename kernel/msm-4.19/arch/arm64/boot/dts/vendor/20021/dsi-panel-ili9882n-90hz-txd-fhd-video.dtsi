&mdss_mdp {
	dsi_ili9882n_90hz_txd_video: qcom,mdss_dsi_ili9882n_90hz_txd_video {
		qcom,mdss-dsi-panel-name =
				"ili9882n 90hz txd fhd video mode dsi panel";
		qcom,mdss-dsi-panel-type = "dsi_video_mode";
		qcom,dsi-ctrl-num = <0>;
		qcom,dsi-phy-num = <0>;
		qcom,mdss-dsi-virtual-channel-id = <0>;
		qcom,mdss-dsi-stream = <0>;
		qcom,mdss-dsi-h-left-border = <0>;
		qcom,mdss-dsi-h-right-border = <0>;
		qcom,mdss-dsi-v-top-border = <0>;
		qcom,mdss-dsi-v-bottom-border = <0>;
		qcom,mdss-dsi-bpp = <24>;
		qcom,mdss-dsi-color-order = "rgb_swap_rgb";
		qcom,mdss-dsi-underflow-color = <0xff>;
		qcom,mdss-dsi-border-color = <0>;
		qcom,mdss-dsi-h-sync-pulse = <0>;
		qcom,mdss-dsi-traffic-mode = "non_burst_sync_event";
		qcom,mdss-dsi-lane-map = "lane_map_0123";
		qcom,mdss-dsi-bllp-eof-power-mode;
		qcom,mdss-dsi-bllp-power-mode;
		qcom,ulps-enabled;
		qcom,suspend-ulps-enabled;
		qcom,mdss-dsi-tx-eot-append;
		qcom,mdss-dsi-lane-0-state;
		qcom,mdss-dsi-lane-1-state;
		qcom,mdss-dsi-lane-2-state;
		qcom,mdss-dsi-lane-3-state;
		qcom,mdss-dsi-dma-trigger = "trigger_sw";
		qcom,mdss-dsi-mdp-trigger = "none";
		qcom,mdss-dsi-lp11-init;
		qcom,mdss-dsi-bl-pmic-control-type = "bl_ctrl_dcs";
		qcom,mdss-dsi-bl-min-level = <1>;
		qcom,mdss-dsi-bl-normal-max-level = <3562>;
		qcom,mdss-dsi-bl-max-level = <4095>;
		qcom,mdss-brightness-normal-max-level = <3562>;
		qcom,mdss-brightness-max-level = <4095>;
		qcom,mdss-brightness-default-level = <400>;
		qcom,mdss-dsi-reset-sequence = <1 10>, <0 10>, <1 10>;
		qcom,mdss-pan-physical-width-dimension = <68>;
		qcom,mdss-pan-physical-height-dimension = <151>;
		oppo,mdss-dsi-vendor-name = "ILI9882N-90HZ";
		oppo,mdss-dsi-manufacture = "TXD";
		qcom,mdss-dsi-display-timings {
			timing@0 {
				qcom,mdss-dsi-video-mode;
				qcom,mdss-dsi-panel-width = <720>;
				qcom,mdss-dsi-panel-height = <1600>;
				qcom,mdss-dsi-h-front-porch = <24>;
				qcom,mdss-dsi-h-back-porch = <20>;
				qcom,mdss-dsi-h-pulse-width = <18>;
				qcom,mdss-dsi-h-sync-skew = <0>;
				qcom,mdss-dsi-v-back-porch = <14>;
				qcom,mdss-dsi-v-front-porch = <358>;
				qcom,mdss-dsi-v-pulse-width = <2>;
				qcom,mdss-dsi-panel-framerate = <90>;
				qcom,mdss-dsi-on-command = [
					39 01 00 00 00 00 04 FF 98 82 01	//GIP Setting
					39 01 00 00 00 00 02 00 46
					39 01 00 00 00 00 02 01 13
					39 01 00 00 00 00 02 02 10
					39 01 00 00 00 00 02 03 20
					39 01 00 00 00 00 02 04 CC
					39 01 00 00 00 00 02 05 13
					39 01 00 00 00 00 02 06 10
					39 01 00 00 00 00 02 07 20
					39 01 00 00 00 00 02 08 82
					39 01 00 00 00 00 02 09 0D
					39 01 00 00 00 00 02 0a F3
					39 01 00 00 00 00 02 0b 00
					39 01 00 00 00 00 02 0c 2B
					39 01 00 00 00 00 02 0d 2B
					39 01 00 00 00 00 02 0e 04
					39 01 00 00 00 00 02 0f 04
					39 01 00 00 00 00 02 10 00
					39 01 00 00 00 00 02 11 00
					39 01 00 00 00 00 02 12 00
					39 01 00 00 00 00 02 1E 00
					39 01 00 00 00 00 02 1F 00
					39 01 00 00 00 00 02 16 82
					39 01 00 00 00 00 02 17 0D
					39 01 00 00 00 00 02 18 73
					39 01 00 00 00 00 02 19 00
					39 01 00 00 00 00 02 1a 2B
					39 01 00 00 00 00 02 1b 2B
					39 01 00 00 00 00 02 1c 04
					39 01 00 00 00 00 02 1d 04
					39 01 00 00 00 00 02 20 00
					39 01 00 00 00 00 02 24 42
					39 01 00 00 00 00 02 25 0b
					39 01 00 00 00 00 02 26 10
					39 01 00 00 00 00 02 27 20
					39 01 00 00 00 00 02 2c 34
					39 01 00 00 00 00 02 31 28
					39 01 00 00 00 00 02 32 0D
					39 01 00 00 00 00 02 33 2A
					39 01 00 00 00 00 02 34 2A
					39 01 00 00 00 00 02 35 29
					39 01 00 00 00 00 02 36 11
					39 01 00 00 00 00 02 37 13
					39 01 00 00 00 00 02 38 15
					39 01 00 00 00 00 02 39 17
					39 01 00 00 00 00 02 3A 19
					39 01 00 00 00 00 02 3B 1B
					39 01 00 00 00 00 02 3C 1D
					39 01 00 00 00 00 02 3D 1F
					39 01 00 00 00 00 02 3E 09
					39 01 00 00 00 00 02 3F 07
					39 01 00 00 00 00 02 40 07
					39 01 00 00 00 00 02 41 07
					39 01 00 00 00 00 02 42 07
					39 01 00 00 00 00 02 43 07
					39 01 00 00 00 00 02 44 07
					39 01 00 00 00 00 02 45 07
					39 01 00 00 00 00 02 46 07
					39 01 00 00 00 00 02 47 28
					39 01 00 00 00 00 02 48 0C
					39 01 00 00 00 00 02 49 2A
					39 01 00 00 00 00 02 4A 2A
					39 01 00 00 00 00 02 4B 29
					39 01 00 00 00 00 02 4C 10
					39 01 00 00 00 00 02 4D 12
					39 01 00 00 00 00 02 4E 14
					39 01 00 00 00 00 02 4F 16
					39 01 00 00 00 00 02 50 18
					39 01 00 00 00 00 02 51 1A
					39 01 00 00 00 00 02 52 1C
					39 01 00 00 00 00 02 53 1E
					39 01 00 00 00 00 02 54 08
					39 01 00 00 00 00 02 55 07
					39 01 00 00 00 00 02 56 07
					39 01 00 00 00 00 02 57 07
					39 01 00 00 00 00 02 58 07
					39 01 00 00 00 00 02 59 07
					39 01 00 00 00 00 02 5A 07
					39 01 00 00 00 00 02 5B 07
					39 01 00 00 00 00 02 5C 07
					39 01 00 00 00 00 02 61 28
					39 01 00 00 00 00 02 62 08
					39 01 00 00 00 00 02 63 2A
					39 01 00 00 00 00 02 64 2A
					39 01 00 00 00 00 02 65 29
					39 01 00 00 00 00 02 66 16
					39 01 00 00 00 00 02 67 14
					39 01 00 00 00 00 02 68 12
					39 01 00 00 00 00 02 69 10
					39 01 00 00 00 00 02 6A 1E
					39 01 00 00 00 00 02 6B 1C
					39 01 00 00 00 00 02 6C 1A
					39 01 00 00 00 00 02 6D 18
					39 01 00 00 00 00 02 6E 0C
					39 01 00 00 00 00 02 6F 07
					39 01 00 00 00 00 02 70 07
					39 01 00 00 00 00 02 71 07
					39 01 00 00 00 00 02 72 07
					39 01 00 00 00 00 02 73 07
					39 01 00 00 00 00 02 74 07
					39 01 00 00 00 00 02 75 07
					39 01 00 00 00 00 02 76 07
					39 01 00 00 00 00 02 77 28
					39 01 00 00 00 00 02 78 09
					39 01 00 00 00 00 02 79 2A
					39 01 00 00 00 00 02 7A 2A
					39 01 00 00 00 00 02 7B 29
					39 01 00 00 00 00 02 7C 17
					39 01 00 00 00 00 02 7D 15
					39 01 00 00 00 00 02 7E 13
					39 01 00 00 00 00 02 7F 11
					39 01 00 00 00 00 02 80 1F
					39 01 00 00 00 00 02 81 1D
					39 01 00 00 00 00 02 82 1B
					39 01 00 00 00 00 02 83 19
					39 01 00 00 00 00 02 84 0D
					39 01 00 00 00 00 02 85 07
					39 01 00 00 00 00 02 86 07
					39 01 00 00 00 00 02 87 07
					39 01 00 00 00 00 02 88 07
					39 01 00 00 00 00 02 89 07
					39 01 00 00 00 00 02 8A 07
					39 01 00 00 00 00 02 8B 07
					39 01 00 00 00 00 02 8C 07
					39 01 00 00 00 00 02 A0 01
					39 01 00 00 00 00 02 A1 0A
					39 01 00 00 00 00 02 A2 04
					39 01 00 00 00 00 02 A3 0A
					39 01 00 00 00 00 02 A4 04
					39 01 00 00 00 00 02 A5 0A
					39 01 00 00 00 00 02 A6 04
					39 01 00 00 00 00 02 A7 0A
					39 01 00 00 00 00 02 A8 0A
					39 01 00 00 00 00 02 A9 04
					39 01 00 00 00 00 02 Aa 04
					39 01 00 00 00 00 02 Ab 0A
					39 01 00 00 00 00 02 Ac 0A
					39 01 00 00 00 00 02 Ad 04
					39 01 00 00 00 00 02 Ae 04
					39 01 00 00 00 00 02 b0 33
					39 01 00 00 00 00 02 b1 33
					39 01 00 00 00 00 02 b2 00
					39 01 00 00 00 00 02 b9 60
					39 01 00 00 00 00 02 c3 ff
					39 01 00 00 00 00 02 ca 44
					39 01 00 00 00 00 02 d0 01
					39 01 00 00 00 00 02 d1 00
					39 01 00 00 00 00 02 dc 37
					39 01 00 00 00 00 02 dd 42
					39 01 00 00 00 00 02 e2 00
					39 01 00 00 00 00 02 e6 23
					39 01 00 00 00 00 02 e7 54
					39 01 00 00 00 00 02 ED 00

					39 01 00 00 00 00 04 FF 98 82 02
					39 01 00 00 00 00 02 F1 1C
					39 01 00 00 00 00 02 4B 5A
					39 01 00 00 00 00 02 50 CA
					39 01 00 00 00 00 02 51 00
					39 01 00 00 00 00 02 06 57
					39 01 00 00 00 00 02 0B A0
					39 01 00 00 00 00 02 0C 80
					39 01 00 00 00 00 02 0D 18
					39 01 00 00 00 00 02 0E 7A
					39 01 00 00 00 00 02 4E 11
					39 01 00 00 00 00 02 4D CE  //ADD 9.21
					39 01 00 00 00 00 02 01 10
					39 01 00 00 00 00 02 02 0A

					39 01 00 00 00 00 04 FF 98 82 03
					39 01 00 00 00 00 02 83 20
					39 01 00 00 00 00 02 84 00

					39 01 00 00 00 00 02 88 E1		//CABC START
					39 01 00 00 00 00 02 89 E8
					39 01 00 00 00 00 02 8A F0
					39 01 00 00 00 00 02 8B F7
					39 01 00 00 00 00 02 8C BF
					39 01 00 00 00 00 02 8D C5
					39 01 00 00 00 00 02 8E C8
					39 01 00 00 00 00 02 8F CE
					39 01 00 00 00 00 02 90 D1
					39 01 00 00 00 00 02 91 D6
					39 01 00 00 00 00 02 92 DC
					39 01 00 00 00 00 02 93 E3
					39 01 00 00 00 00 02 94 ED
					39 01 00 00 00 00 02 95 FA
					39 01 00 00 00 00 02 AF 18
					39 01 00 00 00 00 02 86 3F     //CABC END

					39 01 00 00 00 00 04 FF 98 82 05
					39 01 00 00 00 00 02 03 01
					39 01 00 00 00 00 02 04 12
					39 01 00 00 00 00 02 63 9C
					39 01 00 00 00 00 02 64 9C
					39 01 00 00 00 00 02 68 A1
					39 01 00 00 00 00 02 69 A7
					39 01 00 00 00 00 02 6A B5
					39 01 00 00 00 00 02 6B A7
					//39 01 00 00 00 00 02 85 37 //921 REMOVED
					39 01 00 00 00 00 02 46 00

					// 921 ADD TS START
					39 01 00 00 00 00 02 85 77
					39 01 00 00 00 00 02 47 0A
					39 01 00 00 00 00 02 C8 A1
					39 01 00 00 00 00 02 C9 A1
					39 01 00 00 00 00 02 CA A1
					39 01 00 00 00 00 02 CB 61
					39 01 00 00 00 00 02 D0 A7
					39 01 00 00 00 00 02 D1 A7
					39 01 00 00 00 00 02 D2 A7
					39 01 00 00 00 00 02 D3 67


					39 01 00 00 00 00 04 FF 98 82 07
					39 01 00 00 00 00 02 C0 01
					39 01 00 00 00 00 02 CB CF
					39 01 00 00 00 00 02 CC B0
					39 01 00 00 00 00 02 CD 9D
					39 01 00 00 00 00 02 CE 7E
                                        // 921 ADD TS END

					39 01 00 00 00 00 04 FF 98 82 06
					39 01 00 00 00 00 02 D9 1F
					39 01 00 00 00 00 02 08 00
					39 01 00 00 00 00 02 C0 40
					39 01 00 00 00 00 02 C1 16
					39 01 00 00 00 00 02 06 A4
					39 01 00 00 00 00 02 48 05	//ESD
					39 01 00 00 00 00 02 4D 80	//ESD
					39 01 00 00 00 00 02 4E 40	//ESD
					39 01 00 00 00 00 02 C7 05	//ESD

					39 01 00 00 00 00 04 FF 98 82 08
                                        39 01 00 00 00 00 1C E0 00 24 5B 85 BC 54 EB 11 3D 62 95 9C CB F5 1D AA 47 7A 9C C6 FE EB 1D 5A 8D 03 96  //9.21GAMMA MODIFY
                                        39 01 00 00 00 00 1C E1 00 24 5B 85 BC 54 EB 11 3D 62 95 9C CB F5 1D AA 47 7A 9C C6 FE EB 1D 5A 8D 03 BA

					39 01 00 00 00 00 04 FF 98 82 0B
					39 01 00 00 00 00 02 9A 42
					39 01 00 00 00 00 02 9B D0
					39 01 00 00 00 00 02 9C 02
					39 01 00 00 00 00 02 9D 02
					39 01 00 00 00 00 02 9E 46
					39 01 00 00 00 00 02 9F 46
					39 01 00 00 00 00 02 AB E0

					39 01 00 00 00 00 04 FF 98 82 0E
					39 01 00 00 00 00 02 11 10
					39 01 00 00 00 00 02 13 10
					39 01 00 00 00 00 02 00 A0

					39 01 00 00 00 00 04 FF 98 82 00
					39 01 00 00 00 00 02 53 24		//enable pwm
					39 01 00 00 00 00 03 51 00 00
					39 01 00 00 00 00 02 55 01	//enable cabc
					39 01 00 00 00 00 02 35 00		//TE
					39 01 00 00 78 00 02 11 00
					39 01 00 00 14 00 02 29 00
				];
				qcom,mdss-dsi-off-command = [
					39 01 00 00 00 00 04 FF 98 82 00
					39 01 00 00 14 00 02 28 00
					39 01 00 00 78 00 02 10 00
				];
				qcom,mdss-dsi-cabc-low-mode-command = [
					39 01 00 00 00 00 04 FF 98 82 00
					39 01 00 00 00 00 02 55 01
				];
				qcom,mdss-dsi-cabc-high-mode-command = [
					39 01 00 00 00 00 04 FF 98 82 00
					39 01 00 00 00 00 02 55 02
				];
				qcom,mdss-dsi-cabc-off-command = [
					39 01 00 00 00 00 04 FF 98 82 00
					39 01 00 00 00 00 02 55 00
				];
				qcom,mdss-dsi-on-command-state = "dsi_lp_mode";
				qcom,mdss-dsi-off-command-state = "dsi_lp_mode";
				qcom,mdss-dsi-cabc-low-mode-command-state = "dsi_hs_mode";
				qcom,mdss-dsi-cabc-high-mode-command-state = "dsi_hs_mode";
				qcom,mdss-dsi-cabc-off-command-state = "dsi_hs_mode";
			};
		};
	};
};
