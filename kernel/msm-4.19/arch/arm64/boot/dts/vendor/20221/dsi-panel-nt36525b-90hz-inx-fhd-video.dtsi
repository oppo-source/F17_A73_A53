&mdss_mdp {
	dsi_nt36525b_90hz_inx_video: qcom,mdss_dsi_nt36525b_90hz_inx_video {
		qcom,mdss-dsi-panel-name =
				"nt36525b 90hz inx fhd video mode dsi panel";
		qcom,mdss-dsi-panel-type = "dsi_video_mode";
		qcom,dsi-ctrl-num = <0>;
		qcom,dsi-phy-num = <0>;
		qcom,mdss-dsi-virtual-channel-id = <0>;
		qcom,mdss-dsi-stream = <0>;
		qcom,mdss-dsi-h-left-border = <0>;
		qcom,mdss-dsi-h-right-border = <0>;
		qcom,mdss-dsi-v-top-border = <0>;
		qcom,mdss-dsi-v-bottom-border = <0>;
		qcom,mdss-dsi-bpp = <24>;
		qcom,mdss-dsi-color-order = "rgb_swap_rgb";
		qcom,mdss-dsi-underflow-color = <0xff>;
		qcom,mdss-dsi-border-color = <0>;
		qcom,mdss-dsi-h-sync-pulse = <0>;
		qcom,mdss-dsi-traffic-mode = "non_burst_sync_event";
		qcom,mdss-dsi-lane-map = "lane_map_0123";
		qcom,mdss-dsi-bllp-eof-power-mode;
		qcom,mdss-dsi-bllp-power-mode;
		qcom,ulps-enabled;
		qcom,suspend-ulps-enabled;
		qcom,mdss-dsi-tx-eot-append;
		qcom,mdss-dsi-lane-0-state;
		qcom,mdss-dsi-lane-1-state;
		qcom,mdss-dsi-lane-2-state;
		qcom,mdss-dsi-lane-3-state;
		qcom,mdss-dsi-dma-trigger = "trigger_sw";
		qcom,mdss-dsi-mdp-trigger = "none";
		qcom,mdss-dsi-lp11-init;
		qcom,mdss-dsi-bl-pmic-control-type = "bl_ctrl_dcs";
		qcom,mdss-dsi-bl-min-level = <1>;
		qcom,mdss-dsi-bl-normal-max-level = <3562>;
		qcom,mdss-dsi-bl-max-level = <4095>;
		qcom,mdss-brightness-normal-max-level = <3562>;
		qcom,mdss-brightness-max-level = <4095>;
		qcom,mdss-brightness-default-level = <400>;
		qcom,mdss-dsi-reset-sequence = <1 10>, <0 10>, <1 10>;
		qcom,mdss-pan-physical-width-dimension = <68>;
		qcom,mdss-pan-physical-height-dimension = <151>;
		oppo,mdss-dsi-vendor-name = "NT36525B-90HZ";
		oppo,mdss-dsi-manufacture = "INX";
		qcom,mdss-dsi-display-timings {
			timing@0 {
				qcom,mdss-dsi-video-mode;
				qcom,mdss-dsi-panel-width = <720>;
				qcom,mdss-dsi-panel-height = <1600>;
				qcom,mdss-dsi-h-front-porch = <32>;
				qcom,mdss-dsi-h-back-porch = <40>;
				qcom,mdss-dsi-h-pulse-width = <4>;
				qcom,mdss-dsi-h-sync-skew = <0>;
				qcom,mdss-dsi-v-back-porch = <318>;
				qcom,mdss-dsi-v-front-porch = <18>;
				qcom,mdss-dsi-v-pulse-width = <2>;
				qcom,mdss-dsi-panel-framerate = <90>;
				qcom,mdss-dsi-on-command = [
					39 01 00 00 00 00 02 FF 23
					39 01 00 00 00 00 02 FB 01
					39 01 00 00 00 00 02 00 80	//backlight 12 bit
					39 01 00 00 00 00 02 07 00
					39 01 00 00 00 00 02 08 01
					39 01 00 00 00 00 02 09 00	//pwm 18.5kHz
					39 01 00 00 00 00 02 30 FF   //UI Mode
					39 01 00 00 00 00 02 31 FD
					39 01 00 00 00 00 02 32 F9
					39 01 00 00 00 00 02 33 F7
					39 01 00 00 00 00 02 34 F2
					39 01 00 00 00 00 02 35 EE
					39 01 00 00 00 00 02 36 ED
					39 01 00 00 00 00 02 37 EA
					39 01 00 00 00 00 02 38 EA
					39 01 00 00 00 00 02 39 E9
					39 01 00 00 00 00 02 3A E9
					39 01 00 00 00 00 02 3B E8
					39 01 00 00 00 00 02 3D E7
					39 01 00 00 00 00 02 3F E6
					39 01 00 00 00 00 02 40 E4
					39 01 00 00 00 00 02 41 E2
					39 01 00 00 00 00 02 45 FF  //Still Mode
					39 01 00 00 00 00 02 46 FF
					39 01 00 00 00 00 02 47 F0
					39 01 00 00 00 00 02 48 E8
					39 01 00 00 00 00 02 49 E7
					39 01 00 00 00 00 02 4A D9
					39 01 00 00 00 00 02 4B D6
					39 01 00 00 00 00 02 4C D2
					39 01 00 00 00 00 02 4D D0
					39 01 00 00 00 00 02 4E D0
					39 01 00 00 00 00 02 4F CE
					39 01 00 00 00 00 02 50 CC
					39 01 00 00 00 00 02 51 CA
					39 01 00 00 00 00 02 52 CA
					39 01 00 00 00 00 02 53 C5
					39 01 00 00 00 00 02 54 BF
					39 01 00 00 00 00 02 FF 10
					39 01 00 00 00 00 02 FB 01
					39 01 00 00 00 00 02 53 24
					39 01 00 00 00 00 03 51 00 00
					39 01 00 00 00 00 02 55 01	//enable cabc
					39 01 00 00 00 00 04 3B 03 06 12
					39 01 00 00 00 00 02 FF 25
					39 01 00 00 00 00 02 FB 01
					39 01 00 00 00 00 02 05 00
					39 01 00 00 00 00 02 FF 10
					39 01 00 00 78 00 02 11 00
					39 01 00 00 14 00 02 29 00
				];
				qcom,mdss-dsi-post-on-backlight = [
					05 01 00 00 28 00 02 29 00
				];
				qcom,mdss-dsi-off-command = [
					39 01 00 00 14 00 02 28 00
					39 01 00 00 78 00 02 10 00
				];
				qcom,mdss-dsi-cabc-low-mode-command = [
					39 01 00 00 00 00 02 55 01
				];
				qcom,mdss-dsi-cabc-high-mode-command = [
					39 01 00 00 00 00 02 55 02
				];
				qcom,mdss-dsi-cabc-off-command = [
					39 01 00 00 00 00 02 55 00
				];
				qcom,mdss-dsi-post-on-backlight-state = "dsi_lp_mode";
				qcom,mdss-dsi-on-command-state = "dsi_lp_mode";
				qcom,mdss-dsi-off-command-state = "dsi_lp_mode";
				qcom,mdss-dsi-cabc-low-mode-command-state = "dsi_hs_mode";
				qcom,mdss-dsi-cabc-high-mode-command-state = "dsi_hs_mode";
				qcom,mdss-dsi-cabc-off-command-state = "dsi_hs_mode";
			};
		};
	};
};
