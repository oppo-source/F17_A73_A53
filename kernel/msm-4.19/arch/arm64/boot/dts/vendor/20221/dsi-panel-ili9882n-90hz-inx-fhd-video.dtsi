&mdss_mdp {
	dsi_ili9882n_90hz_inx_video: qcom,mdss_dsi_ili9882n_90hz_inx_video {
		qcom,mdss-dsi-panel-name =
				"ili9882n 90hz inx fhd video mode dsi panel";
		qcom,mdss-dsi-panel-type = "dsi_video_mode";
		qcom,dsi-ctrl-num = <0>;
		qcom,dsi-phy-num = <0>;
		qcom,mdss-dsi-virtual-channel-id = <0>;
		qcom,mdss-dsi-stream = <0>;
		qcom,mdss-dsi-h-left-border = <0>;
		qcom,mdss-dsi-h-right-border = <0>;
		qcom,mdss-dsi-v-top-border = <0>;
		qcom,mdss-dsi-v-bottom-border = <0>;
		qcom,mdss-dsi-bpp = <24>;
		qcom,mdss-dsi-color-order = "rgb_swap_rgb";
		qcom,mdss-dsi-underflow-color = <0xff>;
		qcom,mdss-dsi-border-color = <0>;
		qcom,mdss-dsi-h-sync-pulse = <0>;
		qcom,mdss-dsi-traffic-mode = "non_burst_sync_event";
		qcom,mdss-dsi-lane-map = "lane_map_0123";
		qcom,mdss-dsi-bllp-eof-power-mode;
		qcom,mdss-dsi-bllp-power-mode;
		qcom,ulps-enabled;
		qcom,suspend-ulps-enabled;
		qcom,mdss-dsi-tx-eot-append;
		qcom,mdss-dsi-lane-0-state;
		qcom,mdss-dsi-lane-1-state;
		qcom,mdss-dsi-lane-2-state;
		qcom,mdss-dsi-lane-3-state;
		qcom,mdss-dsi-dma-trigger = "trigger_sw";
		qcom,mdss-dsi-mdp-trigger = "none";
		qcom,mdss-dsi-lp11-init;
		qcom,mdss-dsi-bl-pmic-control-type = "bl_ctrl_dcs";
		qcom,mdss-dsi-bl-min-level = <1>;
		qcom,mdss-dsi-bl-normal-max-level = <3562>;
		qcom,mdss-dsi-bl-max-level = <4095>;
		qcom,mdss-brightness-normal-max-level = <3562>;
		qcom,mdss-brightness-max-level = <4095>;
		qcom,mdss-brightness-default-level = <400>;
		qcom,mdss-dsi-reset-sequence = <1 10>, <0 10>, <1 10>;
		qcom,mdss-pan-physical-width-dimension = <68>;
		qcom,mdss-pan-physical-height-dimension = <151>;
		oppo,mdss-dsi-vendor-name = "INXILI9882N-90HZ";
		oppo,mdss-dsi-manufacture = "INXILI9882N";
		qcom,mdss-dsi-display-timings {
			timing@0 {
				qcom,mdss-dsi-video-mode;
				qcom,mdss-dsi-panel-width = <720>;
				qcom,mdss-dsi-panel-height = <1600>;
				qcom,mdss-dsi-h-front-porch = <24>;
				qcom,mdss-dsi-h-back-porch = <20>;
				qcom,mdss-dsi-h-pulse-width = <18>;
				qcom,mdss-dsi-h-sync-skew = <0>;
				qcom,mdss-dsi-v-back-porch = <14>;
				qcom,mdss-dsi-v-front-porch = <358>;
				qcom,mdss-dsi-v-pulse-width = <2>;
				qcom,mdss-dsi-panel-framerate = <90>;
				qcom,mdss-dsi-on-command = [
                                        39 01 00 00 00 00 04 FF 98 82 02
					39 01 00 00 00 00 02 F1 1C
					39 01 00 00 00 00 02 4B 5A
					39 01 00 00 00 00 02 50 CA
					39 01 00 00 00 00 02 51 00
					39 01 00 00 00 00 02 06 57  //59
					39 01 00 00 00 00 02 0B A0
					39 01 00 00 00 00 02 0C 80
					39 01 00 00 00 00 02 0D 18
					39 01 00 00 00 00 02 0E 7A  //72
					39 01 00 00 00 00 02 4E 11
					39 01 00 00 00 00 02 4D CE  //ADD 9.21
					39 01 00 00 00 00 02 01 10  //
					39 01 00 00 00 00 02 02 0A  //

                                 	39 01 00 00 00 00 04 FF 98 82 03
					39 01 00 00 00 00 02 83 20
					39 01 00 00 00 00 02 84 00
					39 01 00 00 00 00 02 88 E1		//CABC START
					39 01 00 00 00 00 02 89 E8
					39 01 00 00 00 00 02 8A F0
					39 01 00 00 00 00 02 8B F7
					39 01 00 00 00 00 02 8C BF
					39 01 00 00 00 00 02 8D C5
					39 01 00 00 00 00 02 8E C8
					39 01 00 00 00 00 02 8F CE
					39 01 00 00 00 00 02 90 D1
					39 01 00 00 00 00 02 91 D6
					39 01 00 00 00 00 02 92 DC
					39 01 00 00 00 00 02 93 E3
					39 01 00 00 00 00 02 94 ED
					39 01 00 00 00 00 02 95 FA
					39 01 00 00 00 00 02 AF 18
					39 01 00 00 00 00 02 86 3F		// CABC END

					39 01 00 00 00 00 04 FF 98 82 05
					39 01 00 00 00 00 02 03 01
					39 01 00 00 00 00 02 04 12
					39 01 00 00 00 00 02 63 9C
					39 01 00 00 00 00 02 64 9C
					39 01 00 00 00 00 02 68 A1
					39 01 00 00 00 00 02 69 A7
					39 01 00 00 00 00 02 6A B5
					39 01 00 00 00 00 02 6B A7
					// 39 01 00 00 00 00 02 85 37  //921 REMOVED
					39 01 00 00 00 00 02 46 00

					// 921 ADD TS START
					39 01 00 00 00 00 02 85 77
					39 01 00 00 00 00 02 47 0A
					39 01 00 00 00 00 02 C8 A1
					39 01 00 00 00 00 02 C9 A1
					39 01 00 00 00 00 02 CA A1
					39 01 00 00 00 00 02 CB 61
					39 01 00 00 00 00 02 D0 A7
					39 01 00 00 00 00 02 D1 A7
					39 01 00 00 00 00 02 D2 A7
					39 01 00 00 00 00 02 D3 67


					39 01 00 00 00 00 04 FF 98 82 07
					39 01 00 00 00 00 02 C0 01
					39 01 00 00 00 00 02 CB CF
					39 01 00 00 00 00 02 CC B0
					39 01 00 00 00 00 02 CD 9D
					39 01 00 00 00 00 02 CE 7E
                                        // 921 ADD TS END

					39 01 00 00 00 00 04 FF 98 82 06
					39 01 00 00 00 00 02 06 A4
					39 01 00 00 00 00 02 48 05		//ESD
					39 01 00 00 00 00 02 4D 80		//ESD
					39 01 00 00 00 00 02 4E 40		//ESD
					39 01 00 00 00 00 02 C7 05		//ESD

					39 01 00 00 00 00 04 FF 98 82 08
                                        39 01 00 00 00 00 1C E0 00 24 5B 85 BC 54 EB 11 3D 62 95 9C CB F5 1D AA 47 7A 9C C6 FE EB 1D 5A 8D 03 96  //9.21GAMMA MODIFY
                                        39 01 00 00 00 00 1C E1 00 24 5B 85 BC 54 EB 11 3D 62 95 9C CB F5 1D AA 47 7A 9C C6 FE EB 1D 5A 8D 03 BA

					39 01 00 00 00 00 04 FF 98 82 0B
					39 01 00 00 00 00 02 9A 42
					39 01 00 00 00 00 02 9B D0  //E2
					39 01 00 00 00 00 02 9C 02
					39 01 00 00 00 00 02 9D 02
					39 01 00 00 00 00 02 9E 46  //48
					39 01 00 00 00 00 02 9F 46  //48
					39 01 00 00 00 00 02 AB E0

					39 01 00 00 00 00 04 FF 98 82 0E
					39 01 00 00 00 00 02 11 10
					39 01 00 00 00 00 02 13 10
					39 01 00 00 00 00 02 00 A0

					39 01 00 00 00 00 04 FF 98 82 00
					39 01 00 00 00 00 02 53 24		//enable pwm
					39 01 00 00 00 00 03 51 00 00
					39 01 00 00 00 00 02 55 01		//enable cabc
					39 01 00 00 00 00 02 35 00		//TE
					39 01 00 00 78 00 02 11 00
					39 01 00 00 00 00 04 FF 98 82 06 //1012 ADD
					39 01 00 00 00 00 02 D6 50  //1012 ADD
					39 01 00 00 00 00 04 FF 98 82 00 //1012 ADD
					39 01 00 00 14 00 02 29 00
				];
				qcom,mdss-dsi-off-command = [
					39 01 00 00 00 00 04 FF 98 82 00
					39 01 00 00 14 00 02 28 00
					39 01 00 00 78 00 02 10 00
				];
				qcom,mdss-dsi-cabc-low-mode-command = [
					39 01 00 00 00 00 04 FF 98 82 00
					39 01 00 00 00 00 02 55 01
				];
				qcom,mdss-dsi-cabc-high-mode-command = [
					39 01 00 00 00 00 04 FF 98 82 00
					39 01 00 00 00 00 02 55 02
				];
				qcom,mdss-dsi-cabc-off-command = [
					39 01 00 00 00 00 04 FF 98 82 00
					39 01 00 00 00 00 02 55 00
				];
				qcom,mdss-dsi-on-command-state = "dsi_lp_mode";
				qcom,mdss-dsi-off-command-state = "dsi_lp_mode";
				qcom,mdss-dsi-cabc-low-mode-command-state = "dsi_hs_mode";
				qcom,mdss-dsi-cabc-high-mode-command-state = "dsi_hs_mode";
				qcom,mdss-dsi-cabc-off-command-state = "dsi_hs_mode";
			};
		};
	};
};
