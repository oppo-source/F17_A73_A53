&mdss_mdp {
	dsi_ili9882n_90hz_boe_video: qcom,mdss_dsi_ili9882n_90hz_boe_video {
		qcom,mdss-dsi-panel-name =
				"ili9882n 90hz boe fhd video mode dsi panel";
		qcom,mdss-dsi-panel-type = "dsi_video_mode";
		qcom,dsi-ctrl-num = <0>;
		qcom,dsi-phy-num = <0>;
		qcom,mdss-dsi-virtual-channel-id = <0>;
		qcom,mdss-dsi-stream = <0>;
		qcom,mdss-dsi-h-left-border = <0>;
		qcom,mdss-dsi-h-right-border = <0>;
		qcom,mdss-dsi-v-top-border = <0>;
		qcom,mdss-dsi-v-bottom-border = <0>;
		qcom,mdss-dsi-bpp = <24>;
		qcom,mdss-dsi-color-order = "rgb_swap_rgb";
		qcom,mdss-dsi-underflow-color = <0xff>;
		qcom,mdss-dsi-border-color = <0>;
		qcom,mdss-dsi-h-sync-pulse = <0>;
		qcom,mdss-dsi-traffic-mode = "non_burst_sync_event";
		qcom,mdss-dsi-lane-map = "lane_map_0123";
		qcom,mdss-dsi-bllp-eof-power-mode;
		qcom,mdss-dsi-bllp-power-mode;
		qcom,ulps-enabled;
		qcom,suspend-ulps-enabled;
		qcom,mdss-dsi-tx-eot-append;
		qcom,mdss-dsi-lane-0-state;
		qcom,mdss-dsi-lane-1-state;
		qcom,mdss-dsi-lane-2-state;
		qcom,mdss-dsi-lane-3-state;
		qcom,mdss-dsi-dma-trigger = "trigger_sw";
		qcom,mdss-dsi-mdp-trigger = "none";
		qcom,mdss-dsi-lp11-init;
		qcom,mdss-dsi-bl-pmic-control-type = "bl_ctrl_dcs";
		qcom,mdss-dsi-bl-min-level = <1>;
		qcom,mdss-dsi-bl-normal-max-level = <3383>;
		qcom,mdss-dsi-bl-max-level = <4095>;
		qcom,mdss-brightness-normal-max-level = <3383>;
		qcom,mdss-brightness-max-level = <4095>;
		qcom,mdss-brightness-default-level = <400>;
		qcom,mdss-dsi-reset-sequence = <1 10>, <0 10>, <1 10>;
		qcom,mdss-pan-physical-width-dimension = <68>;
		qcom,mdss-pan-physical-height-dimension = <151>;
		oppo,mdss-dsi-vendor-name = "BOEILI9882N-90HZ";
		oppo,mdss-dsi-manufacture = "BOEILI9882N";
		qcom,mdss-dsi-display-timings {
			timing@0 {
				qcom,mdss-dsi-video-mode;
				qcom,mdss-dsi-panel-width = <720>;
				qcom,mdss-dsi-panel-height = <1600>;
				qcom,mdss-dsi-h-front-porch = <32>;
				qcom,mdss-dsi-h-back-porch = <20>;
				qcom,mdss-dsi-h-pulse-width = <8>;
				qcom,mdss-dsi-h-sync-skew = <0>;
				qcom,mdss-dsi-v-back-porch = <18>;
				qcom,mdss-dsi-v-front-porch = <359>;
				qcom,mdss-dsi-v-pulse-width = <2>;
				qcom,mdss-dsi-panel-framerate = <90>;
				qcom,mdss-dsi-on-command = [
					39 01 00 00 00 00 04 FF 98 82 03
					39 01 00 00 00 00 02 83 20          //12bit 15.6k
					39 01 00 00 00 00 02 84 00
					39 01 00 00 00 00 04 FF 98 82 06
					39 01 00 00 00 00 02 06 A4
					39 01 00 00 00 00 04 FF 98 82 03
					39 01 00 00 00 00 02 88 E1          //CABC START
					39 01 00 00 00 00 02 89 E8
					39 01 00 00 00 00 02 8A F0
					39 01 00 00 00 00 02 8B F7
					39 01 00 00 00 00 02 8C BF
					39 01 00 00 00 00 02 8D C5
					39 01 00 00 00 00 02 8E C8
					39 01 00 00 00 00 02 8F CE
					39 01 00 00 00 00 02 90 D1
					39 01 00 00 00 00 02 91 D6
					39 01 00 00 00 00 02 92 DC
					39 01 00 00 00 00 02 93 E3
					39 01 00 00 00 00 02 94 ED
					39 01 00 00 00 00 02 95 FA
					39 01 00 00 00 00 02 AF 18
					39 01 00 00 00 00 02 86 3F          //CABC END
					39 01 00 00 00 00 04 FF 98 82 06
					39 01 00 00 00 00 02 48 05          //ESD
					39 01 00 00 00 00 02 4D 80          //ESD
					39 01 00 00 00 00 02 4E 40          //ESD
					39 01 00 00 00 00 02 C7 05          //ESD
					39 01 00 00 00 00 04 FF 98 82 00
					39 01 00 00 00 00 02 53 24          //enable pwm
					39 01 00 00 00 00 03 51 00 00
					39 01 00 00 00 00 02 55 01          //enable cabc
					39 01 00 00 00 00 02 35 00          //TE
					39 01 00 00 78 00 02 11 00
					39 01 00 00 00 00 04 FF 98 82 01
					39 01 00 00 00 00 02 05 33
					39 01 00 00 00 00 02 07 00
					39 01 00 00 00 00 04 FF 98 82 02
					39 01 00 00 00 00 02 06 57
					39 01 00 00 00 00 02 0D 1C
					39 01 00 00 00 00 02 0E 7B
					39 01 00 00 00 00 04 FF 98 82 0B
					39 01 00 00 00 00 02 9B CE
					39 01 00 00 00 00 02 9E 46
					39 01 00 00 00 00 02 9F 46
					39 01 00 00 00 00 04 FF 98 82 00
					39 01 00 00 14 00 02 29 00
				];
				qcom,mdss-dsi-off-command = [
					39 01 00 00 00 00 04 FF 98 82 00
					39 01 00 00 14 00 02 28 00
					39 01 00 00 78 00 02 10 00
				];
				qcom,mdss-dsi-cabc-low-mode-command = [
					39 01 00 00 00 00 04 FF 98 82 00
					39 01 00 00 00 00 02 55 01
				];
				qcom,mdss-dsi-cabc-high-mode-command = [
					39 01 00 00 00 00 04 FF 98 82 00
					39 01 00 00 00 00 02 55 02
				];
				qcom,mdss-dsi-cabc-off-command = [
					39 01 00 00 00 00 04 FF 98 82 00
					39 01 00 00 00 00 02 55 00
				];
				qcom,mdss-dsi-on-command-state = "dsi_lp_mode";
				qcom,mdss-dsi-off-command-state = "dsi_lp_mode";
				qcom,mdss-dsi-cabc-low-mode-command-state = "dsi_hs_mode";
				qcom,mdss-dsi-cabc-high-mode-command-state = "dsi_hs_mode";
				qcom,mdss-dsi-cabc-off-command-state = "dsi_hs_mode";
			};
		};
	};
};
